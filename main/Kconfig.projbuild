## main/Kconfig.projbuild
```kconfig
menu "Temp_Sens configuration"

    config MQTT_BROKER_URI
        string "MQTT broker URL"
        default "mqtts://192.168.1.40:8883"
        help
            URL of the mqtt broker

    config MQTT_USERNAME
        string "MQTT username"
        default "username"
        help
            Username of the MQTT client

    config MQTT_PASSWORD
        string "MQTT password"
        default "password"
        help
            Password of the MQTT client

    config I2C_MASTER_SCL
        int "SCL GPIO Num"
        default 6 if IDF_TARGET_ESP32C3 || IDF_TARGET_ESP32C2 || IDF_TARGET_ESP32H2
        default 19 if IDF_TARGET_ESP32 || IDF_TARGET_ESP32S2 || IDF_TARGET_ESP32S3
        help
            GPIO number for I2C Master clock line.

    config I2C_MASTER_SDA
        int "SDA GPIO Num"
        default 5 if IDF_TARGET_ESP32C3 || IDF_TARGET_ESP32C2 || IDF_TARGET_ESP32H2
        default 18 if IDF_TARGET_ESP32 || IDF_TARGET_ESP32S2 || IDF_TARGET_ESP32S3
        help
            GPIO number for I2C Master data line.

    config POWER_SAVE_MIN_MODEM
    	bool "Enable minimum powersafe for WiFi"
	default true
	help
	    Enables the minimum powersafe mode for WiFi

    config POWER_SAVE_MAX_MODEM
    	bool "Enable maximum powersafe for WiFi"
	default true
	help
	    Enables the maximum powersafe mode for WiFi

    config WIFI_SSID
        string "WiFi SSID"
        default "myssid"
        help
            SSID (network name) for the example to connect to.

    config WIFI_PASSWORD
        string "WiFi Password"
        default "mypassword"
        help
            WiFi password (WPA or WPA2) for the example to use.
            Can be left blank if the network has no security set.

    config WIFI_LISTEN_INTERVAL
        int "WiFi listen intervall"
	default 3
	help
	    WiFi listen intervall in AP beacon intervals in POWER_SAVE_MAX_MODEM mode
        

endmenu
```
